## arch/x86/sofia/Kconfig
```kconfig
menuconfig X86_INTEL_SOFIA
	bool "Intel SoFIA virtualization"
	select X86_INTEL_XGOLD_VPIC
	select HAVE_DMA_CONTIGUOUS
	select NKERNEL_DDI
	select MOBILEVISOR_VDRIVER
	    help
	Select this options if the kernel is running on top of
	a proprietary VMM as a VM.

config NKERNEL_DDI
	bool

config SOFIA_BOARD_ID
        bool

config MOBILEVISOR_VDRIVER
	bool

menuconfig SOFIA_LOWMEM_DEV
	bool "Sofia low memory version of device"
	default n
	depends on X86_INTEL_SOFIA
	help
	Select this if the target sofia platform
	only has limited memory which needs special
	memory optimization

menuconfig SOFIA_512M_DEV
	bool "Sofia device with 512MB RAM"
	default n
	depends on X86_INTEL_SOFIA
	help
	Select this if the target sofia platform
	only has 512M memory
```

## drivers/gpu/drm/i915/Kconfig
```kconfig
config  DISPLAY_BRIDGE_TOSHIBA_TC35876X_ENABLED
        tristate "Enable Display Via Toshiba Video bridge TC35876X "
	depends on DRM_I915
        default n
	help
         Say Y here if you want to Enable Display Via Toshiba Video bridge TC35876X

config  DISPLAY_BRIDGE_TOSHIBA_TC35876X_AUO_B101XTN01_1
	tristate "Enable AUO B101XTN01_1 Display Via Toshiba Video bridge TC35876X "
	depends on DRM_I915
	default n
      	help
	 Say Y here if you want to Enable AUO B101XTN01_1 Display Via Toshiba Video bridge TC35876X

config  DISPLAY_BRIDGE_TOSHIBA_TC35876X_AUO_B101EAN02_0
        tristate "Enable AUO B080EAN02_0 Display Via Toshiba Video bridge TC35876X "
	depends on DRM_I915
	default n
	help
         Say Y here if you want to Enable AUO_B101EANO2_0 Display Via Toshiba Video bridge TC35876X

config  DISPLAY_BRIDGE_TOSHIBA_TC35876X_CPT_CLA070WP03
        tristate "Enable AUO CLA070WP03 Display Via Toshiba Video bridge TC35876X "
	depends on DRM_I915
	default n
	help
         Say Y here if you want to Enable CPT CLA070WP03 Display Via Toshiba Video bridge TC35876X

config  DISPLAY_BRIDGE_TOSHIBA_TC35876X_CMI_N1ICG
        tristate "Enable CMI N1ICG Display Via Toshiba Video bridge TC35876X "
	depends on DRM_I915
	default n
	help
         Say Y here if you want to Enable CMI N1ICG Display Via Toshiba Video bridge TC35876X

config  DISPLAY_BRIDGE_TOSHIBA_TC35876X_CENTURY_BI097XN02
        tristate "Enable CENTURY BI097XN02 Display Via Toshiba Video bridge TC35876X "
	depends on DRM_I915
	default n
	help
         Say Y here if you want to Enable CENTURY BI097XN02 Display Via Toshiba Video bridge TC35876X

	
```

## drivers/iio/pressure/Kconfig
```kconfig
#
# Pressure sensors
#
menu "Pressure sensors"

config HID_SENSOR_PRES
	depends on HID_SENSOR_HUB
	select IIO_BUFFER
	select IIO_TRIGGERED_BUFFER
	select HID_SENSOR_IIO_COMMON
	tristate "HID PRES"
	help
	  Say yes here to build support for the HID SENSOR
	  Ambient light sensor.

endmenu
```

## drivers/input/touchscreen/ft6x36/Kconfig
```kconfig
config TOUCHSCREEN_FOCALTECH_FT6X36
	tristate "Focaltech touchscreen controllers"
	depends on I2C
	help
	  Say Y here if you want to support Focaltech
	  touchscreen controller.
```

## drivers/input/touchscreen/ftxxxx/Kconfig
```kconfig
config TOUCHSCREEN_FOCALTECH_FT5406
	tristate "Focaltech touchscreen controllers"
	depends on I2C
	help
	  Say Y here if you want to support Focaltech
	  touchscreen controller.

config TOUCHSCREEN_FOCALTECH_FT5446
	tristate "Focaltech touchscreen controllers"
	depends on I2C
	help
	  Say Y here if you want to support Focaltech
	  touchscreen controller.
```

## drivers/input/touchscreen/gt910/Kconfig
```kconfig
config TOUCHSCREEN_GT910
	tristate "goodix gt910 touchscreen"
	depends on I2C
	default n
	help
	  Say Y here if you have a goodix gt910 touchscreen.

config TOUCHSCREEN_GT915
	tristate "goodix gt915 touchscreen"
	depends on I2C
	default n
	help
	  Say Y here if you have a goodix gt915 touchscreen.

config TOUCHSCREEN_GT911
	tristate "goodix gt911 touchscreen"
	depends on I2C
	default n
	help
	  Say Y here if you have a goodix gt911 touchscreen.
	
config TOUCHSCREEN_GT9157
	tristate "goodix gt9157 touchscreen"
	depends on I2C
	default n
	help
	  Say Y here if you have a goodix gt9157 touchscreen.
```

## drivers/input/touchscreen/zet6273/Kconfig
```kconfig
config TOUCHSCREEN_ZET6273
	tristate "ZETEC touchscreen controllers"
	depends on I2C
	help
	  Say Y here if you want to support ZETEC
	  touchscreen controller.
```
