#ifdef SOFIA3G_CATALOG_MRD5S_DISPLAY
#ifdef CONFIG_DISPLAY_NT35512S
graphics {
		compatible = "intel,graphics";
		intel,gpu-shared-mem = <0x20000000>;
		intel,dcc-fbpixelformat= "RGB888";
		intel,dcc-debug-level = <1>;
#ifdef RECOVERY_KERNEL
		intel,fb-api = <1>;
		intel,dcc-mem = < 0x00800000 >;
#else
		intel,dcc-use-fences = <1>;
		intel,dcc-mem = < 0x00400000 >;
		intel,prot-mem = < 0x30800000 0xB800000>;
#endif
		intel,display-fps = <60>;
		intel,display-ramless = <1>;
		intel,display-preinit = <0>;
		intel,display-if = <&mipi_dsi>;
		intel,display-if-rate = <390000000>;
		/include/ "catalog/display/nt35512s.dtsi"
		mipi_dsi:mipi-dsi {
				intel,display-if-min = <104000000>;
				intel,display-if-max = <550000000>;
				intel,display-if-nblanes = <2>;
				intel,display-if-phy-pwup = <6>;
				intel,display-if-phy-calib = <3>;
				intel,display-if-phy-to_lp_hs_req = <24>;
				intel,display-if-phy-to_lp_hs_dis = <25>;
				intel,display-if-phy-to_lp_hs_eot = <60>;
				intel,display-if-phy-to_hs_zero = <8>;
				intel,display-if-phy-to_hs_flip = <24>;
				intel,display-if-phy-lp_clk_div = <31>;
				intel,display-if-phy-to_hs_clk_pre = <36>;
				intel,display-if-phy-to_hs_clk_post = <42>;
				intel,display-if-phy-data_delay = <7>;
				intel,display-if-phy-clock_delay = <7>;
				intel,display-if-phy-lp_tx_tfall = <2>;
				intel,display-if-phy-lp_tx_rise = <2>;
				intel,display-if-phy-lp_tx_vref = <31>;
		};
	};
#endif
#ifdef CONFIG_DISPLAY_NT35521S
	graphics {
		compatible = "intel,graphics";
		intel,gpu-shared-mem = <0x20000000>;
		intel,dcc-fbpixelformat= "RGB888";
		intel,dcc-debug-level = <1>;
#ifdef RECOVERY_KERNEL
		intel,fb-api = <1>;
		intel,dcc-mem = < 0x00800000 >;
#else
		intel,dcc-use-fences = <1>;
		intel,dcc-mem = < 0x00400000 >;
		intel,prot-mem = < 0x30800000 0xB800000>;
#endif
		intel,display-fps = <60>;
		intel,display-ramless = <1>;
		intel,display-preinit = <0>;
		intel,display-if = <&mipi_dsi>;
		intel,display-if-rate = <420000000>;
		/include/ "catalog/display/nt35521s.dtsi"
		mipi_dsi:mipi-dsi {
				intel,display-if-min = <104000000>;
				intel,display-if-max = <550000000>;
				intel,display-if-nblanes = <4>;
				intel,display-if-phy-pwup = <6>;
				intel,display-if-phy-calib = <3>;
				intel,display-if-phy-to_lp_hs_req = <24>;
				intel,display-if-phy-to_lp_hs_dis = <25>;
				intel,display-if-phy-to_lp_hs_eot = <60>;
				intel,display-if-phy-to_hs_zero = <8>;
				intel,display-if-phy-to_hs_flip = <24>;
				intel,display-if-phy-lp_clk_div = <31>;
				intel,display-if-phy-to_hs_clk_pre = <36>;
				intel,display-if-phy-to_hs_clk_post = <42>;
				intel,display-if-phy-data_delay = <7>;
				intel,display-if-phy-clock_delay = <7>;
				intel,display-if-phy-lp_tx_tfall = <2>;
				intel,display-if-phy-lp_tx_rise = <2>;
				intel,display-if-phy-lp_tx_vref = <31>;
		};
	};
#endif
#ifdef CONFIG_DISPLAY_RM68172
	graphics {
		compatible = "intel,graphics";
		intel,gpu-shared-mem = <0x20000000>;
		intel,dcc-fbpixelformat= "RGB888";
		intel,dcc-debug-level = <1>;
#ifdef RECOVERY_KERNEL
		intel,fb-api = <1>;
		intel,dcc-mem = < 0x00800000 >;
#else
		intel,dcc-use-fences = <1>;
		intel,dcc-mem = < 0x00400000 >;
		intel,prot-mem = < 0x30800000 0xB800000>;
#endif
		intel,display-fps = <60>;
		intel,display-ramless = <1>;
		intel,display-preinit = <0>;
		intel,display-if = <&mipi_dsi>;
		intel,display-if-rate = <350000000>;
		/include/ "catalog/display/rm68172.dtsi"
		mipi_dsi:mipi-dsi {
				intel,display-if-min = <104000000>;
				intel,display-if-max = <420000000>;
				intel,display-if-nblanes = <2>;
				intel,display-if-phy-pwup = <6>;
				intel,display-if-phy-calib = <3>;
				intel,display-if-phy-to_lp_hs_req = <24>;
				intel,display-if-phy-to_lp_hs_dis = <25>;
				intel,display-if-phy-to_lp_hs_eot = <60>;
				intel,display-if-phy-to_hs_zero = <8>;
				intel,display-if-phy-to_hs_flip = <24>;
				intel,display-if-phy-lp_clk_div = <31>;
				intel,display-if-phy-to_hs_clk_pre = <36>;
				intel,display-if-phy-to_hs_clk_post = <42>;
				intel,display-if-phy-data_delay = <7>;
				intel,display-if-phy-clock_delay = <7>;
				intel,display-if-phy-lp_tx_tfall = <2>;
				intel,display-if-phy-lp_tx_rise = <2>;
				intel,display-if-phy-lp_tx_vref = <31>;
		};
	};
#endif
#ifdef CONFIG_DISPLAY_RM68191
	graphics {
		compatible = "intel,graphics";
		intel,gpu-shared-mem = <0x20000000>;
		intel,dcc-fbpixelformat= "RGB888";
		intel,dcc-debug-level = <1>;
#ifdef RECOVERY_KERNEL
		intel,fb-api = <1>;
		intel,dcc-mem = < 0x00800000 >;
#else
		intel,dcc-use-fences = <1>;
		intel,dcc-mem = < 0x00400000 >;
		intel,prot-mem = < 0x30800000 0xB800000>;
#endif
		intel,display-fps = <60>;
		intel,display-ramless = <1>;
		intel,display-preinit = <0>;
		intel,display-if = <&mipi_dsi>;
		intel,display-if-rate = <435000000>;
		/include/ "catalog/display/rm68191.dtsi"
		mipi_dsi:mipi-dsi {
				intel,display-if-min = <104000000>;
				intel,display-if-max = <550000000>;
				intel,display-if-nblanes = <2>;
				intel,display-if-phy-pwup = <6>;
				intel,display-if-phy-calib = <3>;
				intel,display-if-phy-to_lp_hs_req = <24>;
				intel,display-if-phy-to_lp_hs_dis = <25>;
				intel,display-if-phy-to_lp_hs_eot = <60>;
				intel,display-if-phy-to_hs_zero = <8>;
				intel,display-if-phy-to_hs_flip = <24>;
				intel,display-if-phy-lp_clk_div = <31>;
				intel,display-if-phy-to_hs_clk_pre = <36>;
				intel,display-if-phy-to_hs_clk_post = <42>;
				intel,display-if-phy-data_delay = <7>;
				intel,display-if-phy-clock_delay = <7>;
				intel,display-if-phy-lp_tx_tfall = <2>;
				intel,display-if-phy-lp_tx_rise = <2>;
				intel,display-if-phy-lp_tx_vref = <31>;
		};
	};
#endif
#ifdef CONFIG_DISPLAY_RM68200GA0
	graphics {
		compatible = "intel,graphics";
		intel,gpu-shared-mem = <0x20000000>;
		intel,dcc-fbpixelformat= "RGB888";
		intel,dcc-debug-level = <1>;
#ifdef RECOVERY_KERNEL
		intel,fb-api = <1>;
		intel,dcc-mem = < 0x00800000 >;
#else
		intel,dcc-use-fences = <1>;
		intel,dcc-mem = < 0x00400000 >;
		intel,prot-mem = < 0x30800000 0xB800000>;
#endif
		intel,display-fps = <60>;
		intel,display-ramless = <1>;
		intel,display-preinit = <0>;
		intel,display-if = <&mipi_dsi>;
		intel,display-if-rate = <435000000>;
		/include/ "catalog/display/rm68200ga0.dtsi"
		mipi_dsi:mipi-dsi {
				intel,display-if-min = <104000000>;
				intel,display-if-max = <550000000>;
				intel,display-if-nblanes = <4>;
				intel,display-if-phy-pwup = <6>;
				intel,display-if-phy-calib = <3>;
				intel,display-if-phy-to_lp_hs_req = <24>;
				intel,display-if-phy-to_lp_hs_dis = <25>;
				intel,display-if-phy-to_lp_hs_eot = <60>;
				intel,display-if-phy-to_hs_zero = <8>;
				intel,display-if-phy-to_hs_flip = <24>;
				intel,display-if-phy-lp_clk_div = <31>;
				intel,display-if-phy-to_hs_clk_pre = <36>;
				intel,display-if-phy-to_hs_clk_post = <42>;
				intel,display-if-phy-data_delay = <7>;
				intel,display-if-phy-clock_delay = <7>;
				intel,display-if-phy-lp_tx_tfall = <2>;
				intel,display-if-phy-lp_tx_rise = <2>;
				intel,display-if-phy-lp_tx_vref = <31>;
		};
	};
#endif
#ifdef CONFIG_DISPLAY_ILI9806E
	graphics {
		compatible = "intel,graphics";
		intel,gpu-shared-mem = <0x20000000>;
		intel,dcc-fbpixelformat= "RGB888";
		intel,dcc-debug-level = <3>;
#ifdef RECOVERY_KERNEL
		intel,fb-api = <1>;
		intel,dcc-mem = < 0x00800000 >;
#else
		intel,dcc-use-fences = <1>;
		intel,dcc-mem = < 0x00400000 >;
		intel,prot-mem = < 0x30800000 0xB800000>;
#endif
		intel,display-fps = <60>;
		intel,display-ramless = <1>;
		intel,display-preinit = <0>;
		intel,display-if = <&mipi_dsi>;
		intel,display-if-rate = <390000000>;
		/include/ "catalog/display/ili9806e.dtsi"
		mipi_dsi:mipi-dsi {
				intel,display-if-min = <104000000>;
				intel,display-if-max = <550000000>;
				intel,display-if-nblanes = <2>;
				intel,display-if-phy-pwup = <6>;
				intel,display-if-phy-calib = <3>;
				intel,display-if-phy-to_lp_hs_req = <24>;
				intel,display-if-phy-to_lp_hs_dis = <25>;
				intel,display-if-phy-to_lp_hs_eot = <60>;
				intel,display-if-phy-to_hs_zero = <8>;
				intel,display-if-phy-to_hs_flip = <24>;
				intel,display-if-phy-lp_clk_div = <31>;
				intel,display-if-phy-to_hs_clk_pre = <36>;
				intel,display-if-phy-to_hs_clk_post = <42>;
				intel,display-if-phy-data_delay = <7>;
				intel,display-if-phy-clock_delay = <7>;
				intel,display-if-phy-lp_tx_tfall = <2>;
				intel,display-if-phy-lp_tx_rise = <2>;
				intel,display-if-phy-lp_tx_vref = <31>;
		};
	};
#endif
#ifdef CONFIG_DISPLAY_ILI9881_3
	graphics {
		compatible = "intel,graphics";
		intel,gpu-shared-mem = <0x20000000>;
		intel,dcc-fbpixelformat= "RGB888";
		intel,dcc-debug-level = <1>;
#ifdef RECOVERY_KERNEL
		intel,fb-api = <1>;
		intel,dcc-mem = < 0x00800000 >;
#else
		intel,dcc-use-fences = <1>;
		intel,dcc-mem = < 0x00400000 >;
		intel,prot-mem = < 0x30800000 0xB800000>;
#endif
		intel,display-fps = <60>;
		intel,display-ramless = <1>;
		intel,display-preinit = <0>;
		intel,display-if = <&mipi_dsi>;
		intel,display-if-rate = <390000000>;
		/include/ "catalog/display/ili9881-3.dtsi"
		mipi_dsi:mipi-dsi {
				intel,display-if-min = <104000000>;
				intel,display-if-max = <550000000>;
				intel,display-if-nblanes = <4>;
				intel,display-if-phy-pwup = <6>;
				intel,display-if-phy-calib = <3>;
				intel,display-if-phy-to_lp_hs_req = <24>;
				intel,display-if-phy-to_lp_hs_dis = <25>;
				intel,display-if-phy-to_lp_hs_eot = <60>;
				intel,display-if-phy-to_hs_zero = <8>;
				intel,display-if-phy-to_hs_flip = <24>;
				intel,display-if-phy-lp_clk_div = <31>;
				intel,display-if-phy-to_hs_clk_pre = <36>;
				intel,display-if-phy-to_hs_clk_post = <42>;
				intel,display-if-phy-data_delay = <7>;
				intel,display-if-phy-clock_delay = <7>;
				intel,display-if-phy-lp_tx_tfall = <2>;
				intel,display-if-phy-lp_tx_rise = <2>;
				intel,display-if-phy-lp_tx_vref = <31>;
		};
	};
#endif
#ifdef CONFIG_DISPLAY_HX8260A
	graphics {
		compatible = "intel,graphics";
		intel,gpu-shared-mem = <0x20000000>;
		intel,dcc-fbpixelformat= "RGB888";
		intel,dcc-debug-level = <1>;
#ifdef RECOVERY_KERNEL
		intel,fb-api = <1>;
		intel,dcc-mem = < 0x00800000 >;
#else
		intel,dcc-use-fences = <1>;
		intel,dcc-mem = < 0x00400000 >;
		intel,prot-mem = < 0x30800000 0xB800000>;
#endif
		intel,display-fps = <60>;
		intel,display-ramless = <1>;
		intel,display-preinit = <0>;
		intel,display-if = <&mipi_dsi>;
		intel,display-if-rate = <430000000>;
		/include/ "catalog/display/HX8260A.dtsi"
		mipi_dsi:mipi-dsi {
				intel,display-if-min = <104000000>;
				intel,display-if-max = <550000000>;
				intel,display-if-nblanes = <4>;
				intel,display-if-phy-pwup = <6>;
				intel,display-if-phy-calib = <3>;
				intel,display-if-phy-to_lp_hs_req = <24>;
				intel,display-if-phy-to_lp_hs_dis = <25>;
				intel,display-if-phy-to_lp_hs_eot = <60>;
				intel,display-if-phy-to_hs_zero = <8>;
				intel,display-if-phy-to_hs_flip = <24>;
				intel,display-if-phy-lp_clk_div = <31>;
				intel,display-if-phy-to_hs_clk_pre = <36>;
				intel,display-if-phy-to_hs_clk_post = <42>;
				intel,display-if-phy-data_delay = <7>;
				intel,display-if-phy-clock_delay = <7>;
				intel,display-if-phy-lp_tx_tfall = <2>;
				intel,display-if-phy-lp_tx_rise = <2>;
				intel,display-if-phy-lp_tx_vref = <31>;
		};
	};
#endif
#ifdef CONFIG_DISPLAY_HX8279A
	graphics {
		compatible = "intel,graphics";
		intel,gpu-shared-mem = <0x20000000>;
		intel,dcc-fbpixelformat= "RGB888";
		intel,dcc-debug-level = <3>;
#ifdef RECOVERY_KERNEL
		intel,fb-api = <1>;
		intel,dcc-mem = < 0x00800000 >;
#else
		intel,dcc-use-fences = <0>;
		intel,dcc-mem = < 0x00400000 >;
		intel,prot-mem = < 0x30800000 0xB800000>;
#endif
		intel,display-fps = <60>;
		intel,display-ramless = <1>;
		intel,display-preinit = <0>;
		intel,display-if = <&mipi_dsi>;
		intel,display-if-rate = <260000000>;
		/include/ "catalog/display/HX8279A.dtsi"
		mipi_dsi:mipi-dsi {
				intel,display-if-min = <104000000>;
				intel,display-if-max = <550000000>;
				intel,display-if-nblanes = <4>;
				intel,display-if-phy-pwup = <6>;
				intel,display-if-phy-calib = <3>;
				intel,display-if-phy-to_lp_hs_req = <24>;
				intel,display-if-phy-to_lp_hs_dis = <25>;
				intel,display-if-phy-to_lp_hs_eot = <60>;
				intel,display-if-phy-to_hs_zero = <8>;
				intel,display-if-phy-to_hs_flip = <24>;
				intel,display-if-phy-lp_clk_div = <31>;
				intel,display-if-phy-to_hs_clk_pre = <36>;
				intel,display-if-phy-to_hs_clk_post = <42>;
				intel,display-if-phy-data_delay = <7>;
				intel,display-if-phy-clock_delay = <7>;
				intel,display-if-phy-lp_tx_tfall = <2>;
				intel,display-if-phy-lp_tx_rise = <2>;
				intel,display-if-phy-lp_tx_vref = <31>;
		};
	};
#endif
#ifdef CONFIG_DISPLAY_HX8379C
	graphics {
		compatible = "intel,graphics";
		intel,gpu-shared-mem = <0x20000000>;
		intel,dcc-fbpixelformat= "RGB888";
		intel,dcc-debug-level = <1>;
#ifdef RECOVERY_KERNEL
		intel,fb-api = <1>;
		intel,dcc-mem = < 0x00800000 >;
#else
		intel,dcc-use-fences = <1>;
		intel,dcc-mem = < 0x00400000 >;
		intel,prot-mem = < 0x30800000 0xB800000>;
#endif
		intel,display-fps = <60>;
		intel,display-ramless = <1>;
		intel,display-preinit = <0>;
		intel,display-if = <&mipi_dsi>;
		intel,display-if-rate = <325000000>;
		/include/ "catalog/display/HX8379C.dtsi"
		mipi_dsi:mipi-dsi {
				intel,display-if-min = <104000000>;
				intel,display-if-max = <550000000>;
				intel,display-if-nblanes = <2>;
				intel,display-if-phy-pwup = <6>;
				intel,display-if-phy-calib = <3>;
				intel,display-if-phy-to_lp_hs_req = <24>;
				intel,display-if-phy-to_lp_hs_dis = <25>;
				intel,display-if-phy-to_lp_hs_eot = <60>;
				intel,display-if-phy-to_hs_zero = <8>;
				intel,display-if-phy-to_hs_flip = <24>;
				intel,display-if-phy-lp_clk_div = <31>;
				intel,display-if-phy-to_hs_clk_pre = <36>;
				intel,display-if-phy-to_hs_clk_post = <42>;
				intel,display-if-phy-data_delay = <7>;
				intel,display-if-phy-clock_delay = <7>;
				intel,display-if-phy-lp_tx_tfall = <2>;
				intel,display-if-phy-lp_tx_rise = <2>;
				intel,display-if-phy-lp_tx_vref = <31>;
		};
	};
#endif
#ifdef CONFIG_DISPLAY_HX8389B
	graphics {
		compatible = "intel,graphics";
		intel,gpu-shared-mem = <0x20000000>;
		intel,dcc-fbpixelformat= "RGB888";
		intel,dcc-debug-level = <1>;
#ifdef RECOVERY_KERNEL
		intel,fb-api = <1>;
		intel,dcc-mem = < 0x00800000 >;
#else
		intel,dcc-use-fences = <1>;
		intel,dcc-mem = < 0x00400000 >;
		intel,prot-mem = < 0x30800000 0xB800000>;
#endif
		intel,display-fps = <60>;
		intel,display-ramless = <1>;
		intel,display-preinit = <0>;
		intel,display-if = <&mipi_dsi>;
		intel,display-if-rate = <390000000>;
		/include/ "catalog/display/HX8389B.dtsi"
		mipi_dsi:mipi-dsi {
				intel,display-if-min = <104000000>;
				intel,display-if-max = <550000000>;
				intel,display-if-nblanes = <2>;
				intel,display-if-phy-pwup = <6>;
				intel,display-if-phy-calib = <3>;
				intel,display-if-phy-to_lp_hs_req = <24>;
				intel,display-if-phy-to_lp_hs_dis = <25>;
				intel,display-if-phy-to_lp_hs_eot = <60>;
				intel,display-if-phy-to_hs_zero = <8>;
				intel,display-if-phy-to_hs_flip = <24>;
				intel,display-if-phy-lp_clk_div = <31>;
				intel,display-if-phy-to_hs_clk_pre = <36>;
				intel,display-if-phy-to_hs_clk_post = <42>;
				intel,display-if-phy-data_delay = <7>;
				intel,display-if-phy-clock_delay = <7>;
				intel,display-if-phy-lp_tx_tfall = <2>;
				intel,display-if-phy-lp_tx_rise = <2>;
				intel,display-if-phy-lp_tx_vref = <31>;
		};
	};
#endif
#ifdef CONFIG_DISPLAY_HX8394C
	graphics {
		compatible = "intel,graphics";
		intel,gpu-shared-mem = <0x20000000>;
		intel,dcc-fbpixelformat= "RGB888";
		intel,dcc-debug-level = <1>;
#ifdef RECOVERY_KERNEL
		intel,fb-api = <1>;
		intel,dcc-mem = < 0x00800000 >;
#else
		intel,dcc-use-fences = <1>;
		intel,dcc-mem = < 0x00400000 >;
		intel,prot-mem = < 0x30800000 0xB800000>;
#endif
		intel,display-fps = <60>;
		intel,display-ramless = <1>;
		intel,display-preinit = <0>;
		intel,display-if = <&mipi_dsi>;
		intel,display-if-rate = <417000000>;
		/include/ "catalog/display/HX8394C.dtsi"
		mipi_dsi:mipi-dsi {
				intel,display-if-min = <104000000>;
				intel,display-if-max = <550000000>;
				intel,display-if-nblanes = <4>;
				intel,display-if-phy-pwup = <6>;
				intel,display-if-phy-calib = <3>;
				intel,display-if-phy-to_lp_hs_req = <24>;
				intel,display-if-phy-to_lp_hs_dis = <25>;
				intel,display-if-phy-to_lp_hs_eot = <60>;
				intel,display-if-phy-to_hs_zero = <8>;
				intel,display-if-phy-to_hs_flip = <24>;
				intel,display-if-phy-lp_clk_div = <31>;
				intel,display-if-phy-to_hs_clk_pre = <36>;
				intel,display-if-phy-to_hs_clk_post = <42>;
				intel,display-if-phy-data_delay = <7>;
				intel,display-if-phy-clock_delay = <7>;
				intel,display-if-phy-lp_tx_tfall = <2>;
				intel,display-if-phy-lp_tx_rise = <2>;
				intel,display-if-phy-lp_tx_vref = <31>;
		};
	};
#endif
#ifdef CONFIG_DISPLAY_JD9161
	graphics {
		compatible = "intel,graphics";
		intel,gpu-shared-mem = <0x20000000>;
		intel,dcc-fbpixelformat= "RGB888";
		intel,dcc-debug-level = <1>;
#ifdef RECOVERY_KERNEL
		intel,fb-api = <1>;
		intel,dcc-mem = < 0x00800000 >;
#else
		intel,dcc-use-fences = <1>;
		intel,dcc-mem = < 0x00400000 >;
		intel,prot-mem = < 0x30800000 0xB800000>;
#endif
		intel,display-fps = <60>;
		intel,display-ramless = <1>;
		intel,display-preinit = <0>;
		intel,display-if = <&mipi_dsi>;
		intel,display-if-rate = <350000000>;
		/include/ "catalog/display/jd9161.dtsi"
		mipi_dsi:mipi-dsi {
				intel,display-if-min = <104000000>;
				intel,display-if-max = <550000000>;
				intel,display-if-nblanes = <2>;
				intel,display-if-phy-pwup = <6>;
				intel,display-if-phy-calib = <3>;
				intel,display-if-phy-to_lp_hs_req = <24>;
				intel,display-if-phy-to_lp_hs_dis = <25>;
				intel,display-if-phy-to_lp_hs_eot = <60>;
				intel,display-if-phy-to_hs_zero = <8>;
				intel,display-if-phy-to_hs_flip = <24>;
				intel,display-if-phy-lp_clk_div = <31>;
				intel,display-if-phy-to_hs_clk_pre = <36>;
				intel,display-if-phy-to_hs_clk_post = <42>;
				intel,display-if-phy-data_delay = <7>;
				intel,display-if-phy-clock_delay = <7>;
				intel,display-if-phy-lp_tx_tfall = <2>;
				intel,display-if-phy-lp_tx_rise = <2>;
				intel,display-if-phy-lp_tx_vref = <31>;
		};
	};
#endif
#ifdef CONFIG_DISPLAY_JD9365
	graphics {
		compatible = "intel,graphics";
		intel,gpu-shared-mem = <0x20000000>;
		intel,dcc-fbpixelformat= "RGB888";
		intel,dcc-debug-level = <1>;
#ifdef RECOVERY_KERNEL
		intel,fb-api = <1>;
		intel,dcc-mem = < 0x00800000 >;
#else
		intel,dcc-use-fences = <1>;
		intel,dcc-mem = < 0x00400000 >;
		intel,prot-mem = < 0x30800000 0xB800000>;
#endif
		intel,display-fps = <60>;
		intel,display-ramless = <1>;
		intel,display-preinit = <0>;
		intel,display-if = <&mipi_dsi>;
		intel,display-if-rate = <402000000>;
		/include/ "catalog/display/jd9365.dtsi"
		mipi_dsi:mipi-dsi {
				intel,display-if-min = <104000000>;
				intel,display-if-max = <550000000>;
				intel,display-if-nblanes = <4>;
				intel,display-if-phy-pwup = <6>;
				intel,display-if-phy-calib = <3>;
				intel,display-if-phy-to_lp_hs_req = <24>;
				intel,display-if-phy-to_lp_hs_dis = <25>;
				intel,display-if-phy-to_lp_hs_eot = <60>;
				intel,display-if-phy-to_hs_zero = <8>;
				intel,display-if-phy-to_hs_flip = <24>;
				intel,display-if-phy-lp_clk_div = <31>;
				intel,display-if-phy-to_hs_clk_pre = <36>;
				intel,display-if-phy-to_hs_clk_post = <42>;
				intel,display-if-phy-data_delay = <7>;
				intel,display-if-phy-clock_delay = <7>;
				intel,display-if-phy-lp_tx_tfall = <2>;
				intel,display-if-phy-lp_tx_rise = <2>;
				intel,display-if-phy-lp_tx_vref = <31>;
		};
	};
#endif
#ifdef CONFIG_DISPLAY_S6D7AA0X01
	graphics {
		compatible = "intel,graphics";
		intel,gpu-shared-mem = <0x20000000>;
		intel,dcc-fbpixelformat= "RGB888";
		intel,dcc-debug-level = <1>;
#ifdef RECOVERY_KERNEL
		intel,fb-api = <1>;
		intel,dcc-mem = < 0x00800000 >;
#else
		intel,dcc-use-fences = <1>;
		intel,dcc-mem = < 0x00400000 >;
		intel,prot-mem = < 0x30800000 0xB800000>;
#endif
		intel,display-fps = <60>;
		intel,display-ramless = <1>;
		intel,display-preinit = <0>;
		intel,display-if = <&mipi_dsi>;
		intel,display-if-rate = <420000000>;
		/include/ "catalog/display/s6d7aa0x01.dtsi"
		mipi_dsi:mipi-dsi {
				intel,display-if-min = <104000000>;
				intel,display-if-max = <550000000>;
				intel,display-if-nblanes = <4>;
				intel,display-if-phy-pwup = <6>;
				intel,display-if-phy-calib = <3>;
				intel,display-if-phy-to_lp_hs_req = <24>;
				intel,display-if-phy-to_lp_hs_dis = <25>;
				intel,display-if-phy-to_lp_hs_eot = <60>;
				intel,display-if-phy-to_hs_zero = <8>;
				intel,display-if-phy-to_hs_flip = <24>;
				intel,display-if-phy-lp_clk_div = <31>;
				intel,display-if-phy-to_hs_clk_pre = <36>;
				intel,display-if-phy-to_hs_clk_post = <42>;
				intel,display-if-phy-data_delay = <7>;
				intel,display-if-phy-clock_delay = <7>;
				intel,display-if-phy-lp_tx_tfall = <2>;
				intel,display-if-phy-lp_tx_rise = <2>;
				intel,display-if-phy-lp_tx_vref = <31>;
		};
	};
#endif
#endif
